## sdkconfig.defaults
```kconfig
CONFIG_AUTOSTART_ARDUINO=y
CONFIG_FREERTOS_HZ=1000

CONFIG_CXX_EXCEPTIONS=y

CONFIG_PARTITION_TABLE_SINGLE_APP_LARGE=y

CONFIG_MBEDTLS_PSK_MODES=y
CONFIG_MBEDTLS_KEY_EXCHANGE_PSK=y
```
